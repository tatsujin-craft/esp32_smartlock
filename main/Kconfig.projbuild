## main/Kconfig.projbuild
```kconfig
menu "Smartlock Configuration"
    config FW_VERSION
        string "FW Version"
        default "v0.0.0"
        help
            FW version.
    
    config PRODUCT_NAME
        string "PRODUCT_NAME"
        default "ESP32 SmartLock"
        help
            Product name.

    config BLE_DEVICE_NAME
        string "BLE device name"
        default "ESP_SMART_LOCK"
        help
            BLE device name.

    config DEBUG_INFORMATION_ENABLED
        bool "Debug information enabled"
        default n   
endmenu
```
